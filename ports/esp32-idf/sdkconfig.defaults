## ports/esp32-idf/sdkconfig.defaults
```kconfig
# ESP32-S3 target; 16 MB flash (N16R8). PSRAM left off for Phase 1 (engine hot
# buffers belong in internal SRAM anyway).
CONFIG_IDF_TARGET="esp32s3"
CONFIG_ESPTOOLPY_FLASHSIZE_16MB=y

# 1 kHz tick so k_msleep(ms) has 1 ms granularity (default 100 Hz = 10 ms).
CONFIG_FREERTOS_HZ=1000

# The codec allocates + the DS-TWR bring-up runs on the main task.
CONFIG_ESP_MAIN_TASK_STACK_SIZE=8192
```

## ports/esp32/components/aliro_reader/Kconfig
```kconfig
menu "Aliro reader"

    config WOZ_ALIRO_LAB
        bool "Aliro Lab transaction trace"
        default y
        help
            Compile in the structured "[ALAB] t=<us> ev=..." trace at transaction
            phase boundaries (connect, auth, ranging setup, first range, bolt) so
            tools/aliro_lab.py can turn a captured serial log into a scored
            walk-up report. Like the sibling `uwbdiag` trace, it ships in every
            Aliro build but stays OFF at boot — the `lab on`/`lab off` console
            command toggles it at runtime, off the UWB hot path. Set n to strip
            it entirely from a hardened production image.

endmenu
```
