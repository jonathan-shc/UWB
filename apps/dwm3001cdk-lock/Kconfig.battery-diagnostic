## apps/dwm3001cdk-lock/Kconfig.battery-diagnostic
```kconfig
menuconfig CUSTOM_BATTERY_DIAGNOSTIC
	bool "Persistent battery discharge diagnostic"
	depends on ADC && SETTINGS
	default n
	help
	  Diagnostic-only mode for calibrating battery status on the DWM3001CDK.
	  Samples the nRF52833 VDD rail every two seconds and persists one sample
	  every ten seconds in the Zephyr settings store so the discharge curve
	  survives power loss. Previous records are dumped on the next boot over RTT.

if CUSTOM_BATTERY_DIAGNOSTIC

config CUSTOM_BATTERY_DIAGNOSTIC_SAMPLE_MS
	int "Live sampling interval (ms)"
	default 2000
	range 500 60000

config CUSTOM_BATTERY_DIAGNOSTIC_STORE_MS
	int "Persistent sample interval (ms)"
	default 10000
	range 2000 120000
	help
	  One flash-backed record is written at this interval. Ten seconds is
	  intentionally much slower than the ADC sampling rate to limit flash wear.

config CUSTOM_BATTERY_DIAGNOSTIC_SLOTS
	int "Persistent ring slots"
	default 256
	range 32 512
	help
	  Number of records retained. At the default ten-second interval, 256 slots
	  retain the final 42 minutes and 40 seconds of a discharge, which is the
	  region most useful for seeing whether VDD droops before shutdown.

endif
```

## apps/dwm3001cdk-lock/Kconfig.battery-status
```kconfig
config CUSTOM_BATTERY_STATUS
    bool "Matter battery percentage reporting"
    depends on ULTRAWIDELOCK_MATTER_BLE
    default n
    help
      Adds the downstream battery status extension. When disabled, no battery
      source code or Matter battery hooks are compiled.
```

## apps/dwm3001cdk-lock/Kconfig.unlock-gate
```kconfig
config ULTRAWIDELOCK_UNLOCK_GATE_SWITCH
	bool "Owner-controlled Matter switch for passive UWB unlocks"
	depends on ULTRAWIDELOCK_MATTER_BLE
	default n
	help
	  Adds a separate Matter On/Off endpoint that gates only passive UWB/approach
	  unlock grants. ON preserves normal walk-up unlock behaviour; OFF suppresses
	  those passive grants. Intentional Home/NFC paths remain unchanged.

	  This feature is deliberately off by default and isolated so it can be
	  carried as a standalone downstream patch or proposed upstream independently.
```
